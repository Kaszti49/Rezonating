/*
 * Host test for the bring-up firmware's portable code: main/rz_link.c against tools/lab/tests/vectors/link-v0.json,
 * main/rz_decim.c against ml/tests/vectors/decimator_fir.json, and main/rz_drdy.c (DRDY edge classifier) against its
 * own cases and an event-driven reader + ADC FIFO simulation. vectors_gen.h is generated by gen_vectors.py
 * (run_host_tests.py does both and compiles this with the host compiler).
 */
#include <inttypes.h>
#include <math.h>
#include <stdbool.h>
#include <stdint.h>
#include <stdio.h>
#include <string.h>

#include "rz_decim.h"
#include "rz_drdy.h"
#include "rz_link.h"

static int tests_run;
static int failures;
static uint8_t g_raw[RZL_MAX_RAW + 16];
static uint8_t g_wire[RZL_WIRE_LEN(RZL_MAX_RAW) + 16];
static rzl_rx_t g_rx;

#define CHECK(cond, what)                                                                                              \
    do {                                                                                                               \
        if (!(cond)) {                                                                                                 \
            failures++;                                                                                                \
            printf("FAIL %s: %s\n", case_name, what);                                                                  \
        }                                                                                                              \
    } while (0)

static void check_bytes(const char *case_name, const char *what, const uint8_t *got, size_t n, const uint8_t *exp,
                        size_t en)
{
    if (n == en && memcmp(got, exp, n) == 0) {
        return;
    }
    failures++;
    size_t i = 0;
    while (i < n && i < en && got[i] == exp[i]) {
        i++;
    }
    printf("FAIL %s: %s: got %u B, want %u B, first difference at byte %u\n", case_name, what, (unsigned)n,
           (unsigned)en, (unsigned)i);
}

#include "vectors_gen.h"

static void test_decimator(void)
{
    const char *case_name = "decimator_fir";
    rz_decim_t d;
    rz_decim_init(&d, 2);
    int m = 0;
    int exact = 0, code_exact = 0;
    double max_err = 0.0;
    int max_code_diff = 0;
    for (int n = 0; n < DEC_N; n++) {
        /* both channels get the vector's input: ch1 negated, to cover negative rounding too */
        int32_t x[2] = {dec_in[n], -dec_in[n]};
        float y[2];
        bool ok;
        if (!rz_decim_push(&d, x, dec_valid[n] != 0, y, &ok)) {
            continue;
        }
        if (m >= DEC_M) {
            CHECK(0, "more outputs than expected");
            break;
        }
        double err = fabs((double)y[0] - (double)dec_exp[m]);
        if (err > max_err) {
            max_err = err;
        }
        exact += (y[0] == dec_exp[m]);
        CHECK(err <= DEC_TOL_ABS, "output outside tolerance");
        CHECK(y[1] == -y[0], "negated channel is not the exact negative");
        CHECK(ok == (dec_exp_valid[m] != 0), "expected_valid differs");
        int32_t c0 = rz_decim_code(y[0]);
        int32_t c1 = rz_decim_code(y[1]);
        int diff = (int)(c0 > dec_exp_codes[m] ? c0 - dec_exp_codes[m] : dec_exp_codes[m] - c0);
        if (diff > max_code_diff) {
            max_code_diff = diff;
        }
        code_exact += (c0 == dec_exp_codes[m]);
        CHECK(diff <= DEC_TOL_CODES, "code outside tolerance");
        CHECK(c1 == -c0, "rounding is not symmetric (halves away from zero)");
        m++;
    }
    CHECK(m == DEC_M, "output count (n_raw // 2)");
    tests_run++;
    printf("decimator: %d outputs, %d/%d bit-exact floats, max |err| %.3g (tolerance %.3g), %d/%d exact codes, "
           "max code diff %d\n",
           m, exact, DEC_M, max_err, DEC_TOL_ABS, code_exact, DEC_M, max_code_diff);

    /* rounding and saturation edges of to_adc_dec_codes */
    CHECK(rz_decim_code(0.5f) == 1 && rz_decim_code(-0.5f) == -1 && rz_decim_code(1.5f) == 2, "half away from zero");
    CHECK(rz_decim_code(0.49999997f) == 0 && rz_decim_code(-2.5f) == -3, "rounding");
    CHECK(rz_decim_code(8388607.5f) == 8388607 && rz_decim_code(9e6f) == 8388607, "saturate +");
    CHECK(rz_decim_code(-8388608.0f) == -8388608 && rz_decim_code(-9e6f) == -8388608, "saturate -");
}

/* link_mode.c computes CONFIG's scale as (float)(1.2 / gain / 8388608.0); the simulator rounds the same double. */
static void test_config_scale(void)
{
    const char *case_name = "config scale";
    for (int i = 0; i < 8; i++) {
        double g = (double)(1 << i);
        CHECK((float)(1.2 / g / 8388608.0) == cfg_scale_py[i], "scale differs from float32(1.2 / gain / 2^23)");
    }
    tests_run++;
}

/* ---- DRDY edge classifier (main/rz_drdy.c): conversions vs the narrow pulse after a double read ---- */
#define T_US 500 /* 2 kSPS */

/* Classify one wake-up's edges; checks the conversion count, the missed count, the skipped intervals (sum) and the
 * conversion times. */
static void drdy_batch(const char *case_name, rz_drdy_t *d, const int64_t *edges, uint32_t n, uint32_t want_real,
                       uint32_t want_miss, uint32_t want_skip, const int64_t *want_t)
{
    int64_t t[16];
    uint32_t skip[16];
    memcpy(t, edges, n * sizeof t[0]);
    uint32_t n_real = rz_drdy_classify(d, t, skip, n);
    uint32_t n_miss = n_real - rz_drdy_n_read(n_real);
    uint32_t n_skip = 0;
    for (uint32_t i = 0; i < n_real; i++) {
        n_skip += skip[i];
    }
    if (n_real != want_real || n_miss != want_miss || n_skip != want_skip) {
        failures++;
        printf("FAIL %s: %u conversions, %u missed, %u skipped; want %u, %u, %u\n", case_name, (unsigned)n_real,
               (unsigned)n_miss, (unsigned)n_skip, (unsigned)want_real, (unsigned)want_miss, (unsigned)want_skip);
        return;
    }
    for (uint32_t i = 0; i < n_real && want_t != NULL; i++) {
        CHECK(t[i] == want_t[i], "conversion edge times");
    }
}

static rz_drdy_kind_t edge1(rz_drdy_t *d, int64_t t, uint32_t *skipped)
{
    uint32_t s;
    return rz_drdy_edge(d, t, skipped != NULL ? skipped : &s);
}

static void test_drdy_cases(void)
{
    rz_drdy_t d;
    {
        const char *case_name = "drdy normal (one edge per wake-up, +-60 us jitter)";
        static const int jit[] = {0, 60, -60, 35, -10, 60, -60, 0};
        rz_drdy_init(&d, T_US);
        for (int i = 0; i < 8; i++) {
            int64_t e = 1000 + (int64_t)T_US * i + jit[i];
            drdy_batch(case_name, &d, &e, 1, 1, 0, 0, &e);
        }
        tests_run++;
    }
    {
        const char *case_name = "drdy late reader: 2 queued frames, then the narrow pulse";
        rz_drdy_init(&d, T_US);
        int64_t a = 1000;
        drdy_batch(case_name, &d, &a, 1, 1, 0, 0, NULL);
        static const int64_t late[] = {1500, 2000}; /* both conversions still in the FIFO: read 2, none missed */
        drdy_batch(case_name, &d, late, 2, 2, 0, 0, late);
        rz_drdy_t save = d;
        static const int64_t pulse[] = {2040}; /* narrow pulse after the first of the two reads: nothing to read */
        drdy_batch(case_name, &d, pulse, 1, 0, 0, 0, NULL);
        d = save;
        static const int64_t pulse_next[] = {2040, 2500};
        drdy_batch(case_name, &d, pulse_next, 2, 1, 0, 0, &pulse_next[1]);
        d = save;
        /* late again with the pulse queued: pending 3 but only 2 conversions, both in the FIFO (the old reader
         * counted pending - 2 = 1 missed here: a phantom raw index) */
        static const int64_t pulse_late[] = {2040, 2500, 3000};
        drdy_batch(case_name, &d, pulse_late, 3, 2, 0, 0, &pulse_late[1]);
        tests_run++;
    }
    {
        const char *case_name = "drdy real miss (pending > 2)";
        rz_drdy_init(&d, T_US);
        int64_t a = 1000;
        drdy_batch(case_name, &d, &a, 1, 1, 0, 0, NULL);
        static const int64_t miss2[] = {1500, 2000, 2500, 3000}; /* 4 conversions: 2 overwritten, 2 read */
        drdy_batch(case_name, &d, miss2, 4, 4, 2, 0, miss2);
        static const int64_t pulse_miss[] = {3020, 3500, 4000, 4500}; /* pulse + 3 conversions: 1 missed */
        drdy_batch(case_name, &d, pulse_miss, 4, 3, 1, 0, &pulse_miss[1]);
        tests_run++;
    }
    {
        const char *case_name = "drdy pulse in the period: mid, near the next grid point, unclaim, moved";
        rz_drdy_init(&d, T_US);
        static const int64_t ab[] = {500, 1000};
        drdy_batch(case_name, &d, ab, 2, 2, 0, 0, NULL);
        rz_drdy_t save = d;
        /* pulse 263 us after B, next conversion 299 us after the pulse (both gaps over half a period): only the
         * conversion counts */
        static const int64_t mid[] = {1263, 1562};
        drdy_batch(case_name, &d, mid, 2, 1, 0, 0, &mid[1]);
        d = save;
        int64_t p = 1400; /* within T / 3 of the next grid point: taken for a conversion */
        drdy_batch(case_name, &d, &p, 1, 1, 0, 0, &p);
        rz_drdy_unclaim(&d); /* its read found no new data */
        int64_t c = 1500;
        drdy_batch(case_name, &d, &c, 1, 1, 0, 0, &c); /* one period after the restored reference: no skip */
        d = save;
        static const int64_t both[] = {1400, 1500}; /* same wake-up: one conversion, its time moved to 1500 */
        drdy_batch(case_name, &d, both, 2, 1, 0, 0, &both[1]);
        int64_t next = 2000;
        drdy_batch(case_name, &d, &next, 1, 1, 0, 0, &next);
        d = save;
        drdy_batch(case_name, &d, &p, 1, 1, 0, 0, &p); /* pulse taken in one wake-up ... */
        CHECK(edge1(&d, 1505, NULL) == RZ_DRDY_MOVED, "... the conversion right after it takes its place");
        CHECK(edge1(&d, 2000, NULL) == RZ_DRDY_CONV, "grid continues from the moved conversion");
        tests_run++;
    }
    {
        const char *case_name = "drdy gaps: an edge the interrupt missed, an outage (PROTOCOL.md 4.4: g - 1 skipped)";
        rz_drdy_init(&d, T_US);
        int64_t a = 1000;
        drdy_batch(case_name, &d, &a, 1, 1, 0, 0, NULL);
        int64_t b = 2010; /* 2 periods: the edge at 1500 was not seen */
        drdy_batch(case_name, &d, &b, 1, 1, 0, 1, &b);
        static const int64_t c[] = {2490, 4510, 5000}; /* T - 20; then 4 periods (3 skipped); then T */
        drdy_batch(case_name, &d, c, 3, 3, 1, 3, c);
        int64_t far = 5000 + 10 * T_US + 240; /* outage: 10.48 periods -> 10, 9 skipped */
        drdy_batch(case_name, &d, &far, 1, 1, 0, 9, &far);
        tests_run++;
    }
    {
        /* The race: a late wake-up takes C, C + 1; C + 2 converts before the first SPI read, so the FIFO drops C and
         * the reads return C + 1, C + 2 (labeled C, C + 1). C + 2's own edge then reads stale and is given back;
         * C + 3 is two periods after the restored reference and reports 1 skipped interval: 2 + 0 + (1 + 1) = 4
         * indices for 4 conversions, back in step. */
        const char *case_name = "drdy FIFO moved before the first read (race), healed by the skip";
        rz_drdy_init(&d, T_US);
        int64_t a = 1000;
        drdy_batch(case_name, &d, &a, 1, 1, 0, 0, NULL);
        static const int64_t late[] = {1500, 2000};
        drdy_batch(case_name, &d, late, 2, 2, 0, 0, late);
        int64_t c2 = 2500;
        drdy_batch(case_name, &d, &c2, 1, 1, 0, 0, &c2);
        rz_drdy_unclaim(&d); /* its read found no new data */
        int64_t c3 = 3000;
        drdy_batch(case_name, &d, &c3, 1, 1, 0, 1, &c3);
        tests_run++;
    }
    {
        const char *case_name = "drdy reference handling";
        uint32_t s = 99;
        rz_drdy_init(&d, T_US);
        CHECK(edge1(&d, 100, &s) == RZ_DRDY_CONV && s == 0, "first edge without a reference: conversion, no skip");
        CHECK(edge1(&d, 100 + T_US - 167, &s) == RZ_DRDY_PULSE && s == 0, "T - 167 us: pulse");
        CHECK(edge1(&d, 100 + T_US - 166, NULL) == RZ_DRDY_CONV, "T - 166 us (within T / 3): conversion");
        CHECK(edge1(&d, 434 + T_US + 166, NULL) == RZ_DRDY_CONV, "T + 166 us: conversion");
        CHECK(edge1(&d, 1100 + T_US + 249, NULL) == RZ_DRDY_PULSE, "1.498 periods: pulse");
        CHECK(edge1(&d, 1100 + T_US + 250, &s) == RZ_DRDY_CONV && s == 1, "1.5 periods: conversion after 1 skip");
        rz_drdy_unclaim(&d); /* back to 1100 */
        CHECK(edge1(&d, 1100 + 250, NULL) == RZ_DRDY_PULSE, "unclaim goes back to the conversion before");
        rz_drdy_unclaim(&d); /* second in a row: no reference */
        CHECK(edge1(&d, 9000, &s) == RZ_DRDY_CONV && s == 0, "after two unclaims: conversion, no skip");
        rz_drdy_reset(&d);
        CHECK(edge1(&d, 99000, &s) == RZ_DRDY_CONV && s == 0, "after reset: conversion, no skip");
        tests_run++;
    }
    {
        const char *case_name = "drdy left-over frame detector";
        rz_drdy_lo_t lo;
        rz_drdy_lo_init(&lo);
        CHECK(!rz_drdy_leftover(&lo, 0), "no pulse: nothing left over");
        rz_drdy_leftover_reads(&lo, 2); /* double read: its pulse is expected */
        CHECK(!rz_drdy_leftover(&lo, 1), "the double read's pulse: nothing left over");
        rz_drdy_leftover_reads(&lo, 1);
        CHECK(rz_drdy_leftover(&lo, 1), "pulse after a single read: a frame is left over (drain)");
        rz_drdy_leftover_reads(&lo, 1);
        CHECK(!rz_drdy_leftover(&lo, 1), "the drain read's own pulse (yet another frame queued): no second drain");
        rz_drdy_leftover_reads(&lo, 1);
        CHECK(rz_drdy_leftover(&lo, 1), "... but the next unexplained pulse drains again");
        rz_drdy_leftover_reads(&lo, 2);
        CHECK(!rz_drdy_leftover(&lo, 0), "expected pulse not seen yet");
        CHECK(!rz_drdy_leftover(&lo, 1), "it arrives one wake-up later: still explained");
        tests_run++;
    }
}

/* ---- reader + ADC simulation, event-driven ----
 * Conversions every T (nominal 500 us, scaled by a rate error in ppm). Each DRDY edge reaches the reader at its
 * interrupt time = true time + latency (uniform 0 .. jit us, plus rare spikes); a conversion edge can also be lost
 * (the interrupt never sees it). The reader wakes 3 us after the first pending interrupt (or when it is ready again),
 * takes every edge whose interrupt has run, classifies them with rz_drdy.c and does what bringup_main.c does: an
 * unexplained pulse drains one left-over frame (no index), missed conversions take lost indices after their skipped
 * intervals, the newest one or two are read; the newest read with no new data or a CRC error gives its edge (and its
 * skipped intervals) back, an older one is a lost sample on its own index. The first SPI read starts read_delay us
 * after the wake-up and each read takes read_us; the FIFO is sampled at each read's start, so with read time a
 * conversion can land between the wake-up and a read (the race). A read that leaves a frame queued makes a narrow
 * pulse 40 .. 120 us after its start. The reader is late (up to 1700 us) on 1 wake-up in 16. Checks: the final raw
 * index equals the next conversion to read (offset 0) and every run of reads landing on another conversion's index
 * is at most max_run long. Known limit (not a case here): interrupt latency above about 120 us (spread or rare
 * spikes) can shift the index by one for good. */
static uint64_t sim_rs;
static double sim_ur(void)
{
    sim_rs = sim_rs * 6364136223846793005ULL + 1442695040888963407ULL;
    return (double)(uint32_t)(sim_rs >> 33) / 2147483648.0;
}

typedef struct {
    const char *name;
    uint32_t seed;
    double jit, ppm, read_delay, read_us, spike_p, spike_us, lost_edge_p, crc_p;
    int max_run;
} sim_cfg_t;

static void test_drdy_sim(const sim_cfg_t *c)
{
    const char *case_name = c->name;
    sim_rs = c->seed;
    const double T = T_US * (1.0 + c->ppm * 1e-6);
    rz_drdy_t d;
    rz_drdy_init(&d, T_US);
    static int64_t pend[256]; /* interrupt times of edges not yet taken, sorted */
    int np = 0;
    double pulse_t[16];
    int npulse = 0;
    int64_t ngen = 0, next_unread = 0;
    uint64_t index = 0, reads = 0, missed = 0, skipped = 0, stale = 0, crcs = 0, pulses = 0, mism = 0, onsets = 0;
    uint64_t drains = 0;
    rz_drdy_lo_t lo;
    rz_drdy_lo_init(&lo);
    int run = 0, max_run = 0;
    double ready = 0;
    bool overflow = false;
    while (ngen < 400000) {
        double tc = 1000.0 + (double)ngen * T;
        double tp = 1e300;
        int ip = -1;
        for (int i = 0; i < npulse; i++) {
            if (pulse_t[i] < tp) {
                tp = pulse_t[i];
                ip = i;
            }
        }
        double wake = np ? ((ready > (double)pend[0] ? ready : (double)pend[0]) + 3.0) : 1e300;
        double te = tc < tp ? tc : tp;
        if (te <= wake) { /* the next DRDY edge happens before the reader wakes: its interrupt runs */
            bool is_conv = tc < tp;
            if (is_conv) {
                ngen++;
            } else {
                pulse_t[ip] = pulse_t[--npulse];
            }
            if (is_conv && c->lost_edge_p > 0 && sim_ur() < c->lost_edge_p) {
                continue; /* the interrupt never saw it */
            }
            double lat = sim_ur() * c->jit + (c->spike_p > 0 && sim_ur() < c->spike_p ? c->spike_us : 0.0);
            if (np == (int)(sizeof pend / sizeof pend[0])) {
                overflow = true;
                break;
            }
            pend[np] = (int64_t)(te + lat);
            for (int i = np++; i > 0 && pend[i] < pend[i - 1]; i--) {
                int64_t x = pend[i];
                pend[i] = pend[i - 1];
                pend[i - 1] = x;
            }
            continue;
        }
        int64_t t[32];
        uint32_t skip[32];
        uint32_t n = 0;
        while ((int)n < np && (double)pend[n] <= wake && n < 32) {
            t[n] = pend[n];
            n++;
        }
        memmove(pend, pend + n, (size_t)(np - (int)n) * sizeof pend[0]);
        np -= (int)n;
        uint32_t n_real = rz_drdy_classify(&d, t, skip, n);
        uint32_t n_read = rz_drdy_n_read(n_real);
        double rt = wake + c->read_delay;
        if (rz_drdy_leftover(&lo, n - n_real)) {
            /* a pulse no double read explains: a frame was left in the FIFO; read it and drop it */
            double x = (rt - 1000.0) / T;
            int64_t happened = x < 0 ? 0 : (int64_t)x + 1;
            int64_t oldest = next_unread > happened - 2 ? next_unread : happened - 2;
            if (oldest < happened) {
                next_unread = oldest + 1;
                if (next_unread < happened && npulse < 16) {
                    pulse_t[npulse++] = rt + 40.0 + sim_ur() * 80.0;
                    pulses++;
                }
            }
            drains++;
            rt += c->read_us;
        }
        rz_drdy_leftover_reads(&lo, n_read);
        for (uint32_t i = 0; i < n_real; i++) {
            if (i < n_real - n_read) {
                index += skip[i] + 1u; /* skipped intervals, then the missed conversion */
                skipped += skip[i];
                missed++;
                continue;
            }
            bool newest = i == n_real - 1;
            double x = (rt - 1000.0) / T; /* conversions done by the read's start */
            int64_t happened = x < 0 ? 0 : (int64_t)x + 1;
            int64_t oldest = next_unread > happened - 2 ? next_unread : happened - 2; /* FIFO keeps the newest 2 */
            bool is_stale = oldest >= happened;
            bool is_crc = c->crc_p > 0 && sim_ur() < c->crc_p;
            rt += c->read_us;
            if (!is_stale) {
                next_unread = oldest + 1; /* the frame left the FIFO, even with a CRC error */
                if (next_unread < happened && npulse < 16) {
                    pulse_t[npulse++] = rt - c->read_us + 40.0 + sim_ur() * 80.0;
                    pulses++;
                }
            }
            stale += is_stale;
            crcs += is_crc;
            if (newest && (is_stale || is_crc)) { /* bringup_main.c read_feed: the edge and its skips go back */
                rz_drdy_unclaim(&d);
                continue;
            }
            index += skip[i];
            skipped += skip[i];
            if (is_stale || is_crc) {
                index++; /* a lost sample on its own index */
                continue;
            }
            reads++;
            if ((uint64_t)oldest != index) {
                onsets += run == 0;
                mism++;
                run++;
                max_run = run > max_run ? run : max_run;
            } else {
                run = 0;
            }
            index++;
        }
        ready = rt + 20.0 + (sim_ur() * 16.0 < 1.0 ? sim_ur() * 1700.0 : 0.0);
    }
    int64_t offset = (int64_t)index - next_unread;
    CHECK(!overflow, "pending edge list overflowed");
    CHECK(offset == 0, "final raw index offset is not 0 (indices drifted)");
    CHECK(max_run <= c->max_run, "a run of mislabeled reads is longer than the bound");
    CHECK(missed > 0 && pulses > 0, "simulation did not exercise misses and pulses");
    tests_run++;
    printf("%s: %lld conv, %llu read, %llu missed, %llu skipped, %llu pulses, %llu stale, %llu crc, %llu drained; "
           "offset %lld, %llu mislabeled reads in %llu events (longest %d)\n",
           c->name, (long long)ngen, (unsigned long long)reads, (unsigned long long)missed,
           (unsigned long long)skipped, (unsigned long long)pulses, (unsigned long long)stale,
           (unsigned long long)crcs, (unsigned long long)drains, (long long)offset, (unsigned long long)mism,
           (unsigned long long)onsets, max_run);
}

/* name, seed, jitter us, rate error ppm, first-read delay us, read us, spike probability, spike us, lost-edge
 * probability, CRC-error probability per read, longest mislabeled run allowed */
static const sim_cfg_t drdy_sims[] = {
    {"drdy sim instant reads, jitter 40 us", 12345u, 40, 0, 0, 0, 0, 0, 0, 0, 6},
    {"drdy sim timed reads (race), jitter 5 us", 1u, 5, 0, 15, 60, 0, 0, 0, 0, 6},
    {"drdy sim timed reads, first read after 1 us, jitter 2 us", 2u, 2, 0, 1, 60, 0, 0, 0, 0, 6},
    {"drdy sim timed reads, jitter 80 us, +1.65 %", 3u, 80, 16500, 40, 60, 0, 0, 0, 0, 6},
    {"drdy sim timed reads, jitter 100 us, -1.65 %", 4u, 100, -16500, 15, 60, 0, 0, 0, 0, 6},
    {"drdy sim timed reads, 0.1 % of interrupt edges lost", 5u, 20, 0, 15, 60, 0, 0, 0.001, 0, 6},
    {"drdy sim timed reads, 0.1 % CRC errors", 6u, 20, 0, 15, 60, 0, 0, 0, 0.001, 6},
    {"drdy sim timed reads, jitter 20 us, 0.1 % latency spikes of 100 us", 7u, 20, 0, 15, 60, 0.001, 100, 0, 0, 6},
};

int main(void)
{
    gen_link();
    test_config_scale();
    test_decimator();
    test_drdy_cases();
    for (size_t i = 0; i < sizeof drdy_sims / sizeof drdy_sims[0]; i++) {
        test_drdy_sim(&drdy_sims[i]);
    }
    printf("%d cases, %d failures\n", tests_run, failures);
    return failures ? 1 : 0;
}
